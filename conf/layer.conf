## conf/layer.conf
```bitbake
# We have a conf and classes directory, add to BBPATH
BBPATH .= ":${LAYERDIR}"

# We have a recipes-* directories, add to BBFILES
BBFILES += "${LAYERDIR}/recipes-*/*/*.bb \
	${LAYERDIR}/recipes-*/*/*.bbappend"

BBFILE_COLLECTIONS += "raspberrypi-web"
BBFILE_PATTERN_raspberrypi-web = "^${LAYERDIR}/"
BBFILE_PRIORITY_raspberrypi-web = "10"
LAYERVERSION_raspberrypi-web = "1"
LAYERSERIES_COMPAT_raspberrypi-web = "dunfell"
```
